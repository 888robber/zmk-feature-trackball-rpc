## Kconfig
```kconfig
menu "LisM Trackball RPC"

config TRACKBALL_RPC
    bool "Enable LisM trackball live-settings BLE RPC service"
    depends on BT_PERIPHERAL
    select SETTINGS
    default n

config TRACKBALL_RPC_AML_MAX_ACTION_EVENTS
    int "Max queued automatic-mouse-layer state-change actions"
    depends on TRACKBALL_RPC
    default 4

config LISM_COMBO_RPC
    bool "Enable LisM runtime-editable combos (+ BLE RPC service)"
    depends on BT_PERIPHERAL
    select SETTINGS
    select ZMK_BEHAVIOR_LOCAL_IDS
    default n

config LISM_COMBO_RPC_MAX_COMBOS
    int "Max number of runtime combo slots"
    depends on LISM_COMBO_RPC
    range 1 32
    default 16

config LISM_COMBO_RPC_MAX_PRESSED
    int "Max simultaneously held combos"
    depends on LISM_COMBO_RPC
    default 4

config LISM_COMBO_RPC_TEST_COMBO
    bool "Seed a Q+W -> Esc test combo on first boot (hardware verification)"
    depends on LISM_COMBO_RPC
    default n

endmenu
```

## dts/bindings/lism,input-processor-accel.yaml
```yaml
description: |
  LisM cursor acceleration curve input processor. Applies an extra
  speed-dependent multiplier on top of the flat CPI-based sensitivity:
  moving the trackball faster produces proportionally larger cursor
  jumps. All parameters (enabled, max multiplier, kick-in speed, ramp
  width) are runtime-mutable, live-settable via the trackball RPC
  service — there are no devicetree properties to configure here.

compatible: "lism,input-processor-accel"

include: ip_zero_param.yaml
```

## dts/bindings/lism,input-processor-gesture.yaml
```yaml
# Follows the same bindings-array shape as zmkfirmware/zmk's own
# zmk,input-processor-behaviors.yaml (app/dts/bindings/input_processors/
# zmk,input-processor-behaviors.yaml, v0.3.0), but instead of a 1:1
# event-code-to-behavior map, this accumulates trackball motion and fires
# one of 4 fixed-order behaviors (left/right/up/down) once accumulated
# movement in the dominant axis crosses `threshold`.

description: |
  LisM trackball swipe-gesture detector. Accumulates X/Y motion while
  active and invokes one of 4 behaviors (in order: left, right, up,
  down) once the dominant axis crosses `threshold`, then resets and
  enters a `cooldown-ms` window before it can fire again.

compatible: "lism,input-processor-gesture"

include: ip_zero_param.yaml

properties:
  bindings:
    type: phandle-array
    required: true
    description: exactly 4 behavior bindings, in order [left, right, up, down]
  threshold:
    type: int
    default: 300
    description: accumulated counts in the dominant axis needed to fire a gesture
  cooldown-ms:
    type: int
    default: 300
    description: minimum time after firing before another gesture can fire
```

## dts/bindings/lism,input-processor-runtime-scroll-invert.yaml
```yaml
# Adapted from zmkfirmware/zmk's own zmk,input-processor-scaler.yaml
# (app/dts/bindings/input_processors/zmk,input-processor-scaler.yaml, v0.3.0).
# Same event-type/codes filtering shape, but instead of a devicetree-fixed
# multiplier this driver just negates the matched axis when a runtime flag
# (live-settable via the trackball RPC service) is set.

description: |
  Inverts the sign of matching input events (e.g. scroll wheel axes) when
  a runtime flag is set. The flag defaults to off and is live-adjustable
  via the LisM trackball RPC service (trackball_rpc_apply_scroll_invert).

compatible: "lism,input-processor-runtime-scroll-invert"

include: ip_zero_param.yaml

properties:
  type:
    type: int
    required: true
  codes:
    type: array
    required: true
```

## dts/bindings/lism,input-processor-temp-layer.yaml
```yaml
# Adapted from zmkfirmware/zmk's own zmk,input-processor-temp-layer.yaml
# (app/dts/bindings/input_processors/zmk,input-processor-temp-layer.yaml,
# v0.3.0). Same shape, but the driver behind this compatible reads its
# "how long to wait before auto-deactivating" value from a runtime-mutable
# global (settable live via the trackball RPC service) instead of trusting
# the param2 devicetree cell, which ZMK's own version bakes in at build time.

description: |
  LisM automatic mouse layer input processor. Temporarily activates a
  layer while the trackball is in motion, and deactivates it again after
  an idle period. Unlike upstream zmk,input-processor-temp-layer, the
  idle period (normally param2) is live-adjustable at runtime via the
  LisM trackball RPC service instead of being devicetree-fixed.

compatible: "lism,input-processor-temp-layer"

include: ip_two_param.yaml

properties:
  require-prior-idle-ms:
    type: int
    required: false
    default: 0
    description: Time in milliseconds that must pass after the last keystroke before the layer can be toggled

  excluded-positions:
    type: array
    required: false
    default: []
    description: Array of key positions that will NOT trigger layer deactivation when pressed
```

## dts/bindings/lism,trackball-rpc.yaml
```yaml
description: |
  LisM trackball live-settings RPC bridge. Links the custom BLE RPC
  service (separate from ZMK Studio's own service/characteristic) to the
  PAW3222 trackball sensor device it controls, and to the runtime
  input-processors used for scroll direction invert and the automatic
  mouse layer idle threshold.

  Example:
  / {
      trackball_rpc: trackball_rpc {
          compatible = "lism,trackball-rpc";
          device = <&trackball_central>;
      };
  };

compatible: "lism,trackball-rpc"

properties:
  device:
    type: phandle
    required: true
    description: phandle to the paw3222 trackball sensor device node.
```
